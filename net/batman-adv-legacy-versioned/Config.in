## net/batman-adv-legacy-versioned/Config.in
```kconfig
config KMOD_BATMAN_ADV_LEGACY_VERSIONED_DEBUG_LOG
	bool "enable verbose debug logging"
	depends on PACKAGE_kmod-batman-adv-legacy-versioned
	default n

config KMOD_BATMAN_ADV_LEGACY_VERSIONED_BLA
	bool "enable bridge loop avoidance"
	depends on PACKAGE_kmod-batman-adv-legacy-versioned
	default y

config KMOD_BATMAN_ADV_LEGACY_VERSIONED_DAT
	bool "enable distributed arp table"
	depends on PACKAGE_kmod-batman-adv-legacy-versioned
	default y

config KMOD_BATMAN_ADV_LEGACY_VERSIONED_NC
	bool "enable network coding [requires promisc mode support]"
	depends on PACKAGE_kmod-batman-adv-legacy-versioned
	default n

config KMOD_BATMAN_ADV_LEGACY_VERSIONED_BATCTL
	bool "enable batctl"
	depends on PACKAGE_kmod-batman-adv-legacy-versioned
	default y
	help
	  batctl is a more intuitive managment utility for B.A.T.M.A.N.-Advanced.
	  It is an easier method for configuring batman-adv and
	  provides some additional tools for debugging as well.
```
